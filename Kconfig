## config/west.yml
```yaml
manifest:  
  remotes:  
    - name: zmkfirmware  
      url-base: https://github.com/zmkfirmware  
    - name: na-ka-no
      url-base: https://github.com/na-ka-no
      
  
  projects:  
    - name: zmk
      remote: na-ka-no  # フォークしたリポジトリを参照  
      revision: for-cool642tb_mini  # カスタムブランチ名  
      import: app/west.yml  
    - name: zmk-pmw3610-driver  
      remote: na-ka-no
      revision: main  
  
  self:  
    path: config
```

## shields/Test/Kconfig.defconfig
```kconfig
if SHIELD_ROBA_R

config ZMK_KEYBOARD_NAME
    default "cool642tb-mini_R"

config ZMK_SPLIT
    default y

config ZMK_SPLIT_ROLE_CENTRAL
    default y

endif

if SHIELD_ROBA_L

config ZMK_KEYBOARD_NAME
    default "cool642tb-mini_L"

config ZMK_SPLIT
    default y

endif
```

## shields/cool642tb-mini_L/Kconfig
```kconfig
config SHIELD_COOL642TB_MINI_L
    bool "Cool642TB Mini L"
    depends on SHIELD
```

## shields/cool642tb-mini_R/Kconfig
```kconfig
config SHIELD_COOL642TB_MINI_R
    bool "Cool642TB Mini R"
    depends on SHIELD
```
